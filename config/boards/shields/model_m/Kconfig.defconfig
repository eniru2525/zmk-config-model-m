## config/boards/shields/model_m/Kconfig.defconfig
```kconfig
# Copyright (c) 2020 The ZMK Contributors
# SPDX-License-Identifier: MIT

if SHIELD_MODEL_M

config ZMK_KEYBOARD_NAME
    default "model_m"

endif
```

## config/boards/shields/model_m/Kconfig.shield
```kconfig
# Copyright (c) 2020 The ZMK Contributors
# SPDX-License-Identifier: MIT

config SHIELD_MODEL_M
   def_bool $(shields_list_contains,model_m)
```
